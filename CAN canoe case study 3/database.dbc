VERSION ""

NS_ :

BS_:

BU_: ECU_acc_sender ECU_speed_sender

BO_ 1 Acc_sender_msg: 1 ECU_acc_sender
 SG_ Acc : 0|8@1- (1,0) [0|1] "" Vector__XXX

BO_ 0 Speed_sender_msg: 1 ECU_speed_sender
 SG_ Speed : 0|8@1+ (1,0) [0|180] "" Vector__XXX

BA_DEF_  "BusType" STRING ;
BA_DEF_DEF_  "BusType" "";
BA_ "BusType" "CAN";
